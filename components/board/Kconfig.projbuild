## knob/components/knob_battery/Kconfig
```kconfig
menu "Knob battery gauge (P4)"

config KNOB_BATTERY_GAUGE
    bool "Show the battery gauge on the home screen (ADC GPIO1)"
    default y
    help
        The P4 parity item built ahead of the multimeter ritual: an
        adc_oneshot read on GPIO 1 (ADC1_CH0, behind the board's 10K/10K
        divider) rendered as an iPhone-style battery icon at the bottom
        centre of the shared home screen. The calibration below is the
        PLACEHOLDER LiPo pair --
        honest numbers land when the user-present multimeter session
        settles whether the divider's top rail is the cell or VBUS
        (the schematic draws 5V; the factory gauge read an impossible
        4.6 V). Until then the gauge reads plausible, not verified.

config KNOB_BATTERY_ADC_CHANNEL
    int "ADC1 channel for the battery sense (GPIO1 = 0)"
    default 0
    range 0 7
    help
        ADC_UNIT_1 channel. GPIO 1 is ADC1_CH0 on the S3 (ADC1 only --
        ADC2 is unusable while the radio runs).

config KNOB_BATTERY_DIV_NUM
    int "Divider numerator (cell = sense * NUM / DEN)"
    default 2
    range 1 100
    help
        The 10K/10K divider reads half the cell -> NUM 2, DEN 1. A
        multimeter check may show the top rail is VBUS (5V through the
        divider), not the cell -- the verdict changes these numbers.

config KNOB_BATTERY_DIV_DEN
    int "Divider denominator"
    default 1
    range 1 100

config KNOB_BATTERY_MV_EMPTY
    int "Cell mV at 0 % (LiPo placeholder)"
    default 3300
    range 2500 3800

config KNOB_BATTERY_MV_FULL
    int "Cell mV at 100 % (LiPo placeholder)"
    default 4200
    range 3600 4500

config KNOB_BATTERY_CHARGING_MV
    int "Cell-mV threshold for the charging bolt (0 = bolt off)"
    default 4400
    range 0 5200
    help
        Heuristic, not a signal: the board has no charge-state line, but
        the cell-sense ADC reads the USB rail when docked (bench
        signature ~4522 mV), far above the 4200 mV cell ceiling. At or
        above this threshold the battery icon shows the green fill +
        bolt ("on the dock"). Same honesty class as the placeholder
        percentage -- the multimeter ritual may retire it. 0 hides the
        bolt entirely.

config KNOB_BATTERY_LOW_PCT
    int "Percent at or below which the fill turns red"
    default 20
    range 1 99
    help
        iOS-style low-battery red on the battery icon's fill. The
        percentage itself rides the placeholder calibration, so this
        threshold is decorative until the multimeter session lands.

endmenu
```

## knob/components/knob_link/Kconfig
```kconfig
menu "Companion link (knob)"

    config COMPANION_TOKEN
        int "Shared token byte (must match the clock's COMPANION_TOKEN)"
        range 0 255
        default 0
        help
            Same LAN-trusted posture as the clock side: 0 on either end
            means "accept any". Set both sides to the same non-zero byte
            to keep a curious neighbour off the dial.

    config COMPANION_PORT
        int "Clock UDP listen port"
        range 1024 65535
        default 50188
        help
            The clock's companion listener port (components/companion).
            Discovery runs over mDNS (_moonclock._udp.local); this port
            is the fallback datagram target (broadcast) while unknown.

endmenu
```

## knob/components/knob_moon/Kconfig
```kconfig
menu "Knob moon display"

config KNOB_MOON_TEST_EPOCH
    int "UTC epoch for the static frame (until knob_time lands, K7d)"
    default 1794175200
    help
        The K7b static moon renders this UTC instant (default
        2026-11-08T22:00Z -- the milestone's bench date, so the disk
        can be compared against the published phase of the day).
        K7d's knob_time (esp_sntp over the existing Wi-Fi join)
        replaces this with the real instant; until then the moon view
        never claims a "now" it does not have. This value is USED
        again only under KNOB_TIME_USE_TEST_EPOCH (bench builds):
        production arms exclusively on an SNTP fix, never here.

config KNOB_DEMO_MODE
    bool "Knob demo mode: scripted phase tour (bench comparison)"
    default n
    help
        The knob side of the on-device demo tour (docs/
        verification/demo-mode, mirrors the clocks' UI_DEMO_MODE).
        After the boot presentation (the static frame) the producer
        task walks EIGHT canonical phases of the current synodic month
        (new moon -> waning crescent, epochs pinned at k/8 of the
        month) plus a ninth step on the LIVE current phase (re-baked
        every cycle, events on), holding each for
        KNOB_DEMO_PHASE_SEC. The power ladder stays held (no dim, no
        deep sleep) so a recording never goes dark; the caption shows
        the phase name. Every step logs `phase=<name> cycle=<n>`
        (tag DEMO) for the recording harness. Production builds keep
        this off.

config KNOB_DEMO_PHASE_SEC
    int "Knob demo mode: seconds per phase step"
    depends on KNOB_DEMO_MODE
    default 15
    range 5 600

endmenu
```

## knob/components/knob_power/Kconfig
```kconfig
menu "Knob power (K7e)"

config KNOB_DIM_AFTER_S
    int "Idle seconds before the backlight dims (0 = never)"
    default 15
    range 0 3600
    help
        First rung of the ladder: the backlight duty drops to
        KNOB_DIM_DUTY after this much touch/dial silence. Any activity
        brings it back to full.

config KNOB_DIM_DUTY
    int "Dimmed backlight duty (0..255)"
    default 40
    range 1 254
    help
        LEDC duty while dimmed (full = 255, the vendor's "on").

config KNOB_SLEEP_TIMEOUT_S
    int "Idle seconds before deep sleep (0 = never sleep)"
    default 60
    range 0 36000
    help
        Second rung: esp_deep_sleep_start with EXT0 on dial-A GPIO 8
        (active-LOW). The cold-boot sweep HOLDS the ladder (a
        presentation is never interrupted); the clock's wake policy
        then shows the current phase statically on every wake.

config KNOB_TOUCH_WAKE
    bool "Wake from deep sleep on a screen tap (EXT1 CST816S INT)"
    default y
    help
        Arms EXT1 ANY_LOW on the CST816S INT line (GPIO 9, RTC IO) next
        to the dial-A EXT0, so a tap wakes the knob like a dial detent
        does. Before sleeping, one touch status read clears a pending
        INT pulse (a stale low would re-wake instantly -- the boot-loop
        guard). If the pad rejects EXT1 the supervisor logs it and
        stays dial-only, like KNOB_SLEEP_ALLOW=n does for the sleep
        itself. Bench-verify: tap, then dial, from a dark panel.

config KNOB_SLEEP_ALLOW
    bool "Actually enter deep sleep (n = log-only)"
    default y
    help
        Bench development can keep the device reachable over the
        USB-JTAG serial with n: the supervisor logs the would-be sleep
        (including the EXT0 RTCIO verdict) and stays awake. Production
        ships y. The device page records which mode was benched.

endmenu
```

## knob/components/knob_time/Kconfig
```kconfig
menu "Knob time bridge"

config KNOB_TIME_BOOT_SYNC_MS
    int "Boot NTP fix window (ms)"
    default 20000
    range 5000 120000
    help
        How long the boot arm task waits for the first SNTP fix
        (clock_sync_time_from_ntp with CLOCK_NTP_SERVER) before giving
        up on a trusted fix. After the window the glass arms on the
        NVS snapshot as "last known" (or stays "no time") and a late fix
        re-bakes the STATIC current phase.

config KNOB_TZ
    string "POSIX TZ string for the glass caption (e.g. CET-1CEST,M3.5.0/2,M10.5.0/3)"
    default "UTC0"
    help
        The caption clock formats the instant through this TZ so the
        knob and the clocks agree on glass. Interim home until the
        shared clock_tz settings screen lands (P2 retires this key);
        an invalid POSIX string makes newlib fall back to UTC.

config KNOB_TIME_USE_TEST_EPOCH
    bool "Bench: frozen KNOB_MOON_TEST_EPOCH as now (no SNTP)"
    default n
    help
        Bench builds only: the boot arm treats KNOB_MOON_TEST_EPOCH as
        a trusted instant and never starts SNTP -- this is what keeps
        the K7b/K7c frozen-epoch verifications (blood tint at the
        2025-03-14 eclipse, the single midnight re-bake) reproducible.
        Production leaves this n: SNTP truth or "no time".

endmenu
```
