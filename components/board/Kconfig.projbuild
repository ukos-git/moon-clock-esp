## components/ui/Kconfig
```kconfig
menu "UI Component Configuration"

    config UI_DEEP_SLEEP_COUNTDOWN_SEC
        int "Deep sleep countdown duration (seconds)"
        default 60
        range 60 1800
        help
            Duration in seconds for the countdown timer from light sleep
            to deep sleep. The timer is armed at the LIGHT-SLEEP ENTRY
            (actions.c runs moon_ui_pause(true) and arms the RTC
            countdown in one step -- the dusk pole spin that used to
            carry it was retired 2026-11-13, the sleep depth is a fixed
            timer at the entry now) and triggers the transition to deep
            sleep when it expires.

            Recommended: 30-60 seconds for battery-powered devices.

    config UI_LIGHT_SLEEP_TICK_MS
        int "LVGL tick period in light sleep (milliseconds)"
        default 100
        range 50 1000
        help
            LVGL timer tick period when in light sleep mode.
            Slower tick reduces CPU usage and power consumption.
            Default is 100ms (vs 10ms in active mode).

    config UI_LIGHT_SLEEP_DIM_PCT
        int "Panel brightness in light sleep (percent)"
        default 25
        range 0 100
        help
            The panel's OWN hardware brightness (the CO5300 0x51 command /
            the P4's backlight PWM) while the light-sleep screen is shown:
            the entry ramps DOWN to this level (UI_SCREEN_SWITCH_FADE ms,
            the same pacing as the screen-switch fade) and the wake / an
            alarm ring ramps it back to 100. The sleep frame is static
            (the dusk pole spin retired 2026-11-13) -- the whole display
            simply glows down, the moon included.
            The ramp follows the fade's panel-io rule: it takes the panel
            mutex per 0x51 step and holds the other 0x51 writers
            (s_fade_busy -- the ramps are mutually exclusive), so a
            brightness write is never queued behind a strip DMA that
            could stall the bus (the settings-entry freeze).
            0 = the panel goes fully dark in light sleep (the wake fades
            it back in).

    config UI_CLOCK_ALPHA_PCT
        int "Clock opacity in light sleep (percent)"
        default 20
        range 0 100
        help
            The shared clock widget's LVGL opacity while the light-sleep
            screen is shown, as a percentage (0 = fully hidden, 100 =
            full opacity). The clock is drawn over the panel with this
            "alpha" -- a plain panel has no true alpha channel, so the
            clock's own opacity IS the alpha. Light sleep ALSO dims the
            whole panel to UI_LIGHT_SLEEP_DIM_PCT via the hardware
            brightness; this option dims the clock further relative to
            the moon (e.g. 20 = the clock glows at 20 % over the already
            dimmed panel, the original "barely visible" look). The wake /
            an alarm ring restores the clock to full opacity. Deep sleep
            keeps the dead display (backlight off, clock hidden), so this
            option is light-sleep only. The single shared clock widget
            means one application point (the light-sleep entry) covers
            every moon-background clock display.

    config UI_CLOCK_ROLL_ENABLE
        bool "Clock digits roll to new values (split-flap animation)"
        default n
        help
            Animate a minute pair's change as a roller-style roll (a
            two-line strip, ease-out, 300 ms, in the wheel-delta
            direction -- task #54's split-flap look). The roll fires
            exactly when the seconds arc completes its cycle and read
            as a spurious ARC animation (user 2026-11-13: "the arc
            seems to have an animation active when completing the
            full cycle to update top-to bottom the spinner. If this
            can be switched off, that would be good") -- so it is OFF
            by default: pairs hard-swap in one frame. The roll path
            stays compiled for a build that opts back in (the
            never-animated hard-swap branch is exactly what a
            disabled roll takes).

    config UI_DEMO_MODE
        bool "Demo mode: full on-device tour of every screen and function"
        default n
        help
            A scripted showcase that exercises the whole device, built
            for side-by-side camera recordings of the three boards (the
            bench harness: bench/record_demo.py, docs/verification/
            demo-mode). From the boot bake it plays a looping tour:
            the five moon screens on a rotation with the MM:SS odometer
            clock (the seconds roll through the per-digit odometer every
            second), then -- with UI_DEMO_FULL_TOUR -- the real settings
            walk (every hub icon and sub-screen exit tapped through the
            touch path with a virtual pointer, the WiFi screen opened
            for a real AP scan), the wheel keyboard (mode keys, letter
            taps through the real sector reveal + commit-on-release,
            backspace, discard), the alarm ring script, the light-sleep
            entry and exit, the headless clock-roll script and one bounded
            on-demand WiFi sync. Every phase start logs a machine-
            readable marker on its own serial tag:
                I (12345) DEMO: phase=<name> cycle=<n> screen=<id>
            which the recording harness uses to align the video with the
            serial logs and extract per-phase comparison frames.
            The demo runs until the next reset: it holds the idle timer
            (every demo second counts as activity), skips the hourly
            on-demand WiFi sync, ignores the sync-complete hand-off,
            suppresses the deep-sleep transition and a scheduled alarm
            fire (the demo's own alarm phase re-enables it), so a
            recording run is never cut by a sleep transition, a radio
            wake or an alarm hijacking the display. Touch during the
            demo still works (the real indev is untouched; the demo's
            taps come from a second virtual pointer). Off (default) in
            production builds.

    config UI_DEMO_SCREEN_SEC
        int "Demo mode: seconds per screen in the rotation"
        default 15
        range 5 600
        help
            How long the demo mode (UI_DEMO_MODE) shows each screen of
            the moon rotation before advancing, and how long each
            settings sub-screen of the full-tour walk stays up. 15 s is
            the default; lower it for a faster cycle when recording.

    config UI_DEMO_FULL_TOUR
        bool "Demo mode: run the full tour (settings, wheel, alarm, sleep, roll, sync)"
        depends on UI_DEMO_MODE
        default y
        help
            With y (the default) the demo runs the whole scripted tour
            described under UI_DEMO_MODE. With n it stays the quick
            moon-screen rotation only (the pre-2026-11 behaviour: MM:SS
            odometer + the five moon screens on a loop).

    config UI_MOON_HOURLY_ENABLE
        bool "Once-per-hour moon refresh (fade to black, redraw, fade in)"
        default y
        help
            At each hour boundary the home's moon refreshes behind the
            screen-switch fade machinery: the panel's OWN hardware
            brightness (the CO5300 0x51 command / the P4's backlight
            PWM) ramps to black (UI_MOON_HOURLY_FADE_MS per leg), a
            core-1 task produces the current-phase frame at the HOUR
            CENTRE (TF hour-cache fetch when the card can serve it,
            otherwise a full bake with write-through store), the
            finished frame is displayed as ONE atomic whole-panel flush
            while the panel is still black, and the brightness ramps
            back. Only the brightness animates -- the clock, the alarm
            row and the seconds display keep running. The refresh is
            skipped while the device is idle (light sleep), while a
            moon-less screen is active, and while the orbit / re-bake
            pipelines or another 0x51 ramp own the buffers; a producer
            that misses its 5 s deadline leaves the OLD frame restored.

    config UI_MOON_HOURLY_FADE_MS
        int "Hourly refresh: fade leg time in ms (each leg)"
        depends on UI_MOON_HOURLY_ENABLE
        default UI_SCREEN_SWITCH_FADE
        range 40 2000
        help
            The fade legs of the hourly refresh (down to black and back
            up), paced like the screen-switch fade (UI_SCREEN_SWITCH_FADE)
            with the same 12 steps. The produce pass runs while the
            panel sits at black, so raising this only lengthens the
            dark window (~1.3-2.4 s of bake plus the two ramps).

    config UI_MOON_HOURLY_TFCACHE
        bool "Serve the hourly refresh frames from the TF card cache"
        depends on UI_MOON_HOURLY_ENABLE && UI_MOON_TFCACHE
        default y
        help
            The hourly producer asks the TF hour cache first (one gray
            JPEG per HOUR of the synodic cycle; a hit is a decode
            instead of a ~1.3-2.4 s bake) and write-through stores every
            hour it had to compute. The card mounts LAZILY on the first
            producer to run (the boot replay when UI_MOON_BOOT_REPLAY is
            on, else the first refresh) and every card
            failure falls back silently to the bake path. See
            UI_MOON_TFCACHE for the folder / versioning rules.

    config UI_MOON_BAKE_REVEAL
        bool "Reveal the moon bake strip by strip while it computes"
        depends on UI_MOON_HOURLY_ENABLE
        default y
        help
            Turns the black windows of the current-phase calculation
            (the hourly cold-bake leg, the boot replay's final "now"
            bake) into the calculation made visible: the producer bakes
            the PSRAM bounce strip by strip and publishes a
            rows-completed watermark; the tick converts and displays
            each completed strip as ONE atomic band flush over a moon
            square cleared to black at reveal start -- the moon draws
            itself north to south at the ACTUAL bake rate (the bake is
            the metronome; no animation outruns a computed row). The
            hourly fade choreography pays its fade-in back at the FIRST
            completed strip, so the panel is dark for the fade window
            only, never for fade + bake. TF hour-cache hits have
            nothing to compute and show atomically as before. s_frame
            is never touched during a reveal: any abort (failed cycle,
            blown budget, sleep hand-off) heals the old frame back from
            it. Docs: implementation/bake-reveal. Off: the old
            black-until-computed posture everywhere.

    config TEST_HOURLY_FORCE_S
        int "Test: fire the hourly refresh every N seconds (0 = off)"
        default 0
        range 0 3600
        help
            Test hook: ignore the hour boundary and fire the full hourly
            cycle (fade-out, produce, atomic show, fade-in) every N
            seconds while the home screen is active and the device is
            not idle -- bench acceptance for the fade/refresh legs
            (cold card = miss + bake + store, warm card = fetch). The
            clock, alarm row and seconds keep running through every
            cycle. 0 (default) = off.

    config UI_MOON_BOOT_REPLAY
        bool "Boot: replay the TF hour cache as the boot animation"
        depends on UI_MOON_HOURLY_ENABLE && UI_MOON_HOURLY_TFCACHE && UI_MOON_TFCACHE
        default y
        help
            At boot, a core-1 task replays ALL stored hour frames
            (ascending) as an animation and stops on the newest one; the
            live-computed current phase lands as the final frame right
            after. Without a usable cache (no card, cold folder, version
            wipe) the display stays black until the current phase is
            computed, exactly as before. The frames are shown untinted
            (neutral LUT -- stored grays carry no event tint) as ONE
            atomic whole-panel flush each, drain-witnessed like every
            sanctioned show; the panel brightness never moves (no fade).
            The idle->sleep ladder is held for the presentation and
            re-armed when it ends; a screen switch or sleep entry aborts
            the animation and the day-tick re-bakes the current phase
            later. The card then also carries the cache policy: entries
            older than the last NEW MOON are cleared (the producers
            compute the new-moon floor from the ephemeris and persist it
            in meta.txt) on top of the one-synodic-month cap. The boot
            touches the SD bus for the mount attempt (a card-less boot
            pays ~1 s of probe timeout before the black-to-now path
            lands). Needs the hourly TF legs (they own the bounce buffer
            and the one-shot init this rides on). Demo mode boots without
            the replay.

    config UI_MOON_REPLAY_FPS
        int "Boot replay: target frame rate (fps)"
        depends on UI_MOON_BOOT_REPLAY
        default 8
        range 2 20
        help
            The replay producer's pacing floor (minimum dwell per frame);
            the actual rate is what the 50 ms tick and the whole-panel
            flush allow on top (measured ~6 fps on the S3 -- the sweep-era
            TF-replay throughput). Higher values simply let the producer
            feed as fast as the panel drains.

    config UI_MOON_REPLAY_BUDGET_MS
        int "Boot replay: whole-animation budget (ms)"
        depends on UI_MOON_BOOT_REPLAY
        default 240000
        range 20000 600000
        help
            Wall-clock budget for the replay animation from spawn. On
            overrun the animation stops where it is and the CURRENT phase
            is still baked and shown (the budget cuts the animation,
            never the moon). A full cache at the default pacing lands
            well inside the default 240 s; raise it only if you want the
            whole cycle played regardless.

    config UI_MOON_TFCACHE
        bool "Cache hourly moon frames on the TF card"
        default y
        help
            Persist the hourly refresh's frames on the TF card (one
            small gray JPEG per HOUR of the cycle, e.g. 709 files ~10 MB
            for a full month) under /sdcard/moon_cache/<calcver>_<target>_<px>/,
            so a warm hour reads the frame instead of computing it: the
            panel's dark window shrinks from bake+fade to decode+fade
            (~200 ms + the ramps). Entries are keyed on the hour and
            baked at the HOUR CENTRE (hour*3600+1800), so a cached hour
            is byte-identical across boots and boards. The folder is
            versioned by the calculation (MOON_CALC_VER from git
            describe; bump the repo with commitizen `cz bump` to
            invalidate), and a self-describing meta.txt inside it pins
            the effective BAKE RESOLUTION (plus albedo width / relief /
            JPEG quality): any mismatch wipes and recreates the folder,
            so frames are never served at the wrong resolution. Old
            version folders are deleted on sight; entries older than one
            synodic cycle are evicted when new ones are written (the
            cache never grows past ~29.5 days). Write-through: every
            hour the device had to compute is stored, so the next boot
            within the cycle fetches it. The device works WITHOUT a
            card: missing card, failed mount, undecodable file, foreign
            filesystem or a mid-run detach all fall back silently to
            computing every frame on-device (the card-less path). Frames
            fetched from the card go through the same moon_gray565 tint
            LUT as computed ones -- fetch and compute are pixel-identical
            by construction. The card mounts lazily on the first hourly
            refresh (or by the boot replay producer when
            UI_MOON_BOOT_REPLAY is on -- the only case where boot touches
            the SD bus), and the day's
            sky-event occlusion is part of the cached bake epoch, so a
            cached hour carries exactly what the same epoch would bake.

    config UI_MOON_TFCACHE_JPEG_Q
        int "TF cache JPEG quality (1-100)"
        depends on UI_MOON_TFCACHE
        default 90
        range 1 100
        help
            Quality of the gray JPEGs the hour cache stores. The
            panel verdicts, in order: q 10 (the knob-demo recipe
            class) showed visible blocking/mosquito noise in the flat
            dark and bright areas; q 32 STILL showed it on the panel
            during a warm replay (2026-11-08) even though the flats
            measured clean. 90 is the visually-transparent class for
            gray DCT encoding; the files are a few times larger than
            q 32's ~7.5 KB (400 px) / ~18 KB (650 px), still tens of
            MB for a whole cached cycle, and encode/decode cost is
            resolution-bound, not quality-bound, so the hourly path
            pays almost nothing for it. The folder's meta.txt pins
            the value: a change wipes and re-bakes the cache.

    config TEST_AUTO_WAKE_SEC
        int "Test: auto-wake from sleep after N seconds (0 = off)"
        default 0
        range 0 3600
        help
            Test hook: while the device is in an idle (sleep) state,
            trigger the idle-wake path automatically after N seconds of
            being asleep -- no touch needed. Lets the wake-from-sleep
            transitions (WiFi reconnect, screen switch, moon
            re-bake) be exercised repeatedly without touching
            the device. 0 (default) = off.

    config TEST_SETTINGS_DEMO_SEC
        int "Test: scripted settings run N seconds after boot (0 = off)"
        default 0
        range 0 3600
        help
            Test hook: run the scripted settings flow N seconds after
            boot (waits out the boot sync first): settings hub ->
            pomodoro (set + save a 90-minute interval) -> alarm time
            (set + save 12:35 Mon-Fri, the range-arc default) ->
            light-sleep (set the
            idle timeout + countdown + save) ->
            airplane, logging every transition, the scheduler /
            settings-store writes, and reading the alarm / settings
            files back. Headless acceptance path for the whole
            settings stack (state machine, persistence, scheduler
            math). 0 (default) = off.

    config TEST_SETTINGS_RETURN_SEC
        int "Test: WiFi-scan screen then return home, N seconds after boot (0 = off)"
        default 0
        range 0 3600
        help
            Test hook: N seconds after boot (waits out the boot bake)
            open the settings WiFi screen -- its entry starts the
            background AP scan, whose radio bring-up/scan/teardown
            storm is the same class as the wake-sync storm -- dwell 2 s
            (< the scan's ~3.9 s, so the return lands MID-scan), then
            return HOME so the home screen's atomic switch flush
            overlaps the scan's radio session. Writes
            NOTHING to settings or credentials; the evidence is the
            moon_ui drain/hold lines, the co5300 failure
            signature and the panel itself. 0 (default) = off.

    config TEST_WIFI_SCAN_SEC
        int "Test: open the WiFi settings screen N seconds after boot (0 = off)"
        default 0
        range 0 3600
        help
            Test hook: N seconds after boot (waits out the boot bake
            first), open the settings WiFi screen -- the one that
            starts the background AP scan (wifi_scan_begin) and
            renders the results as rows. Headless verification of the
            scan path (on the P4: the esp_hosted RPC scan through the
            remote C6, including its 5 GHz APs). Idle monitoring is
            turned off while the screen is up so the capture is not
            cut by the sleep transition. 0 (default) = off.

    config TEST_CPU_STATS_SEC
        int "Test: log per-task CPU % every second, N seconds after boot (0 = off)"
        default 0
        range 0 3600
        help
            Test hook: N seconds after boot (so the boot bake is done
            and the device rests), log every task's share of total CPU
            time (FreeRTOS run-time stats) once per second — 10 s on
            the home screen, then 30 s on the settings hub (loading it
            once); each line holds the idle timer awake. Enables the
            FreeRTOS run-time stats tick (the hook's only runtime cost:
            a two-word read on every context switch). One capture
            therefore shows the home-screen CPU and
            the settings-idle CPU on the hub. Headless CPU profiling
            aid; 0 (default) = off.

    config TEST_ROLL_TILT_SEC
        int "Test: headless screen-orientation tilt script N seconds after boot (0 = off)"
        default 0
        range 0 3600
        help
            Test hook: N seconds after boot, feed the real
            90-degree-step orientation pipeline (100 ms gravity
            sampling -> int4 quantization -> 1 s running mean ->
            quadrant decision -> the LVGL transform layer on all 12
            screen roots) synthetic screen-plane gravity for ~25 s:
            resting (seeds the settled reference) -> 90 deg CW tilt
            -> 180 -> 90 deg CCW -> back to rest, so the applied
            values (with the +90 deg base orientation) log
            +90 -> 0 -> -90 -> -180 -> +90 and each run through the
            full window + decision + transform path on the device --
            no physical tilt needed (exercises the PSRAM layer
            allocation and the centre pivot). The 1 s window lags the
            step changes by ~1 s. Idle monitoring is paused for the
            script so it does not light-sleep mid-run.
            0 (default) = off.

    config TEST_ALARM_RING_SEC
        int "Test: fire the alarm ring N seconds after the boot bake (0 = off)"
        default 0
        range 0 3600
        help
            Test hook: N seconds after boot (waits out the boot bake
            first), fire the REAL alarm path (action_alarm_triggered:
            the ring start + the alarm screen); ~9 s later (past the
            2.5 s volume ramp) stop the ring the way the touch dismiss
            does (the ~150 ms fade-out + codec close); re-fire it ~4 s
            later (the codec re-open after the close); ring again, stop
            it again, then finish with the real dismiss
            (action_wake_screen). On the P4 it proves the ES8311
            open/stream/ramp/fade/close/re-open cycle; on the S3 the
            ring functions are no-op stubs, so it exercises the
            alarm-screen path only. One state per second, in the LVGL
            task. 0 (default) = off.

    config TEST_HANG_WATCH
        bool "Test: dump every task's backtrace + abort when the LVGL task stalls (off = never)"
        default n
        help
            Test hook: a 200 ms lv_timer on the LVGL task is the
            heartbeat; a watcher task aborts the system (after printing
            every task's name/state and a symbolized backtrace) when the
            heartbeat is stale for more than 15 s. A hang on the LVGL
            task is otherwise SILENT (no WDT, no assert -- a task parked
            on a portMAX_DELAY lock keeps the CPU1 idle task alive, so
            the task WDT never fires and the console just goes quiet
            while the panel holds a half-drawn frame). 0 (default) =
            off; the hook is a pure diagnostic aid, not for production.

    config TEST_BAKE_NO_RELIEF
        bool "Test: bake without the relief gradient cache (perf A/B)"
        default n
        help
            Test hook: pass a NULL relief cache to every bake (relief-free
            L = clip(d, 0, 1)) to measure how much of the per-frame bake
            cost is the 2 relief-cache PSRAM loads + tangent-basis dots
            vs the common path (base direction, texture tables, albedo
            load, earthshine, tonemap). Temporary profiling aid; off by
            default and visually wrong (flat terminator).

    config UI_IMU_ENABLE
        bool "Drive the moon viewport from the QMI8658 IMU (device tilt)"
        default y
        help
            The moon's in-plane pose is fixed (the burn-in spin was
            removed 2026-11-13 -- the home shows the baked phase static);
            the device tilt (QMI8658 gravity) changes which side of the
            sphere the camera sees (the out-of-plane orbit, see
            UI_MOON_ORBIT_*, and the whole-screen orientation correction,
            UI_CLOCK_ROLL_SIGN). Tilt also counts as user activity: it
            holds the idle timer and wakes the device from sleep. Touch
            is not an input to the moon's pose (it is only the core-UI
            wake input). When the IMU is absent or this is disabled the
            orbit and the tilt-driven activity/wake monitor are off (the
            tilt monitor runs on but gets no pose input).

    config UI_IMU_ACTIVITY_DEG
        int "Tilt activity threshold: departure from the settled pose (degrees)"
        default 5
        range 1 45
        help
            The monitor measures the DEPARTURE (deg) of the current
            pose from a settled-pose reference (a slow EMA that only
            updates while settled), not the delta between two raw
            samples (which amplifies per-sample noise and fired the
            "wakes right after entering sleep" bug). While the device
            is AWAKE, a departure above this threshold counts as user
            activity: it holds the idle timer, so a device operated
            purely by tilt cannot be stranded asleep. At rest the
            departure settles back below it and the reference follows,
            so a still device is free to sleep. A two-consecutive-
            sample streak gates the fire.

    config UI_IMU_WAKE_DEG
        int "Tilt wake threshold: departure from the settled pose (degrees)"
        default 20
        range 5 45
        help
            While the device is ASLEEP, a departure above this
            (deliberate-pick-up) threshold wakes it, gated by a
            two-consecutive-sample streak. Higher than
            UI_IMU_ACTIVITY_DEG on purpose: table vibration and the
            measured at-rest drift (~0.4 deg/s -> ~2.5 deg of steady
            departure) must not wake, only a deliberate tilt. Lower it
            for more sensitive wake.

    config UI_IMU_ANGLE_SIGN
        int "IMU angle sign (+1 or -1, flips the orbit direction)"
        default 1
        range -1 1
        help
            The board's IMU mounting orientation is board-specific; if
            tilting the device peeks the moon the "wrong" way, set this
            to -1. Applies to the orbit (UI_MOON_ORBIT_*) only: the
            tilt activity/wake monitor measures a DEPARTURE (an angle
            from the settled pose), so it is sign-agnostic.

    config UI_IMU_ROLL_OFFSET_DEG
        int "IMU roll offset (degrees, aligns the resting orientation)"
        default 0
        range 0 359
        help
            Obsolete: the moon's in-plane pose is fixed (the burn-in
            spin was removed 2026-11-13), so a resting roll offset has
            no effect. Kept so existing sdkconfig files keep validating.

    config UI_CLOCK_ROLL_SIGN
        int "Screen-orientation correction sign (+1 or -1)"
        default 1
        range -1 1
        help
            The screen-plane gravity vector (the IMU x/y gravity) picks
            the WHOLE-SCREEN orientation: the UI content counter-rotates
            (lv_obj_set_style_transform_rotation on every screen root)
            in 90-degree steps so the UI stays upright relative to the
            resting pose, on the clock, the settings and the alarm
            screens alike (with the orbit, UI_MOON_ORBIT_ENABLE, off on
            the S3 this is the tilt's only UI coupling). The gravity
            x/y is sampled at 10 Hz, a 1 s running mean is the 1 Hz
            low-pass, both axes are quantized to int4, and the
            orientation is the departure of the filtered gravity vector
            from a settled-pose reference (updated only while the
            device is settled, so at-rest drift does not walk the
            orientation around), decided with integer dot/cross only
            (no atan2). Only applied when the screen plane has a
            gravity component (near-vertical or flat the pose is
            undefined and the last orientation is kept). The resting
            orientation (0) costs nothing -- LVGL takes its direct draw
            path -- so the PSRAM transform layer is only paid while the
            device sits in a tilted 90-degree pose. The board's IMU
            mounting orientation may flip the measured tilt; if the UI
            rotates the WRONG way when the device is tilted, set this
            to -1.

    config UI_ORI_BASE_V10
        int "Base screen orientation in 1/10 deg (panel mount offset)"
        # Per-board panel mount offset, first-match-wins order (the
        # moon asset-res precedent): the P4's panel is mounted 90 deg
        # CW off (tuned on the bench, task #54); the S3 AMOLED housing
        # needs a further quarter turn clockwise (bench 2026-11-08: at
        # rest its content sat 90 deg CCW of true up).
        default 900 if BOARD_P4
        default 1800
        range 0 2700
        help
            The whole-screen rotation at orientation step 0 (the pose
            the settled-pose reference anchors to): positive =
            clockwise, LVGL transform units (1/10 deg). Applied at
            init and on every 2 s press re-sync -- this is the single
            source for the panel-mount offset (the shared clock widget
            and every screen root carry it; the burn-in spin's
            pre-rotation it once also fed was removed 2026-11-13).
            Must be a multiple of 900: the orientation pipeline only
            understands quarter turns.

    config UI_MOON_ORBIT_ENABLE
        bool "Sphere model: peek at the dark side via out-of-plane tilt"
        default n
        help
            The moon behaves like a sphere: the out-of-plane tilt of the
            device (the angle between the screen normal and vertical,
            0 deg at vertical / wall-mounted, 90 deg flat on a table)
            rotates the camera around the moon, so the dark side can be
            peeked at -- on a near-full moon this reveals the
            unilluminated limb. This requires a re-bake with a
            pre-rotated camera basis (~1.7-2.4 s with the relief DEM
            on this board); the finished frame is then displayed as one
            atomic whole frame (the same sequential update the
            hourly-refresh and re-bake pipelines use), so the viewport
            change lands as a frame instead of a slow wipe.

            DISABLED by default: the ~2 s relief-DEM re-bake cannot be
            served at the tilt-driven cadence on the ESP32-S3 (the
            display pipeline stalls and the viewport lags the tilt), so
            on the S3 the tilt drives the CLOCK orientation instead
            (UI_CLOCK_ROLL_SIGN) and the moon stays on its default
            viewport. The tilt activity/wake monitor is unaffected.
            Re-enable on the ESP32-P4, which can hold the re-bake rate.

    config UI_MOON_ORBIT_MAX_DEG
        int "Max orbit (peek) angle in degrees"
        default 30
        range 0 60
        help
            The viewport only moves by the tilt up to this limit:
            beyond it the orbit is clamped. 0 disables the orbit
            (the moon stays on its default viewport regardless of
            out-of-plane tilt). A wall-mounted device reads ~0 deg
            (vertical = the default viewport); flat on a table it
            reads 90 deg, which clamps to this limit.

    config UI_MOON_ORBIT_STEP_DEG
        int "Orbit quantization step in degrees (re-bake trigger)"
        default 1
        range 1 10
        help
            The orbit angle is quantized to this step and the re-bake
            only runs when the quantized target moves. 1 degree is the
            default (no visible stutter at rest); raise it (e.g. 3-5)
            if the ~2.3 s re-bake makes viewport changes feel too
            slow for the device's re-draw performance.

    config UI_MOON_ORBIT_DEADZONE_DEG
        int "Orbit dead zone in degrees"
        default 2
        range 0 15
        help
            Quantized orbit angles inside +/- this band map to the
            default viewport (0), so table jitter (at-rest floor
            measured at ~1.5 deg/s mean, 3.3 deg/s p90 at 1 Hz on
            this board) cannot walk the viewport around.

    config UI_MOON_ORBIT_LPF_ALPHA
        int "Orbit low-pass filter coefficient in percent (5-95)"
        default 30
        range 5 95
        help
            Exponential smoothing on the orbit angle, applied at the
            20 Hz UI tick, as a percentage: 30 = alpha 0.30 per tick.
            Together with the dead zone and the quantization step this
            eliminates sensor stutter; raise it for a snappier
            (jitterier) response, lower it for a heavier low-pass.

    config UI_SCREEN_SWITCH_FADE
        int "Screen switch: fade-to-black time in ms (0 = plain atomic switch)"
        default 240
        range 0 2000
        help
            A screen switch (e.g. into the settings hub) dims the
            panel's OWN hardware brightness (the CO5300 0x51 command)
            to black, loads the new screen, displays it as ONE atomic
            whole-panel flush while the panel is still black, then
            ramps the brightness back. The transition writes NO
            pixels -- no overlay, no per-step re-render, no strip
            traffic on the panel bus -- so it is cheap and shows no
            left-to-right crawl. The total switch cost is roughly 2x
            this time (the two ramps) plus one hidden whole-panel
            flush. 0 = the plain instant atomic switch (lv_scr_load
            + one whole-panel flush). EVERY screen switch takes the
            fade; the one exception is the both-moon switch (airplane
            / wifi / the sleep screens share the one moon image),
            which stays atomic.

endmenu
```
