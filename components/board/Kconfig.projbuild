## components/clock/Kconfig
```kconfig
menu "Clock Component Configuration"

    config CLOCK_USE_PCF85063A
        bool "External PCF85063A RTC IC"
        default y
        help
            Use the external PCF85063A RTC (with the TCA9554 IO expander)
            as the time base. The S3 board carries it; the P4 4C does not —
            there the time base is the 32.768 kHz crystal-backed internal
            RTC timer (RTC_CLK_SRC_EXT_CRYS) + SNTP, minute ticks are
            detected in software, and the countdown / alarm arming run on
            esp_timer instead of the PCF85063A hardware registers. When
            disabled, clock_set_alarm / clock_enable_alarm /
            clock_clear_alarm become no-ops (the scheduler's s_next_alarm
            cache is the source of truth for the software alarm).

    choice CLOCK_TIME_FORMAT
        prompt "Time display format"
        default CLOCK_TIME_FORMAT_24H
        help
            Choose between 12-hour (AM/PM) and 24-hour time display format.
            Note: The RTC always stores time in 24-hour format internally.
            This setting only affects how time is displayed in the UI.

        config CLOCK_TIME_FORMAT_24H
            bool "24-hour format (00:00 - 23:59)"
        config CLOCK_TIME_FORMAT_12H
            bool "12-hour format with AM/PM (12:00 AM - 11:59 PM)"
    endchoice

    config CLOCK_DEFAULT_TIMEZONE
        string "Default timezone (POSIX TZ format)"
        default "CET-1CEST,M3.5.0/2,M10.5.0/3"
        help
            Default timezone in POSIX TZ format.
            Examples:
            - "CET-1CEST,M3.5.0/2,M10.5.0/3" (Central European Time with DST)
            - "EST5EDT,M3.2.0,M11.1.0" (Eastern Time US with DST)
            - "UTC0" (UTC time)
            - "JST-9" (Japan Standard Time, no DST)
            - "PST8PDT,M3.2.0,M11.1.0" (Pacific Time US with DST)

    config CLOCK_NTP_SERVER
        string "NTP server hostname"
        default "pool.ntp.org"
        help
            Primary NTP server to synchronize time with.

    config CLOCK_NTP_SYNC_INTERVAL_HOURS
        int "NTP sync interval (hours)"
        default 1
        range 1 168
        help
            Interval between NTP synchronizations in hours (1-168).
            The device activates WiFi on demand (wake + the hourly tick
            while at rest on the airplane screen) purely to refresh the
            RTC, then drops back to airplane mode.

    config CLOCK_NTP_TIMEOUT_MS
        int "NTP synchronization timeout (milliseconds)"
        default 10000
        range 3000 30000
        help
            Maximum time to wait for NTP synchronization.

    config CLOCK_IDLE_TIMEOUT_SEC
        int "Idle timeout in seconds"
        default 60
        range 60 1800
        help
            Time in seconds of no user interaction before switching to deep sleep screen.
            The timer resets on any touch/display interaction.

    config CLOCK_IDLE_CHECK_INTERVAL_MS
        int "Idle check interval (milliseconds)"
        default 1000
        range 500 5000
        help
            How often to check for idle timeout (in milliseconds).
            Lower values provide more precise timing but use more CPU.

endmenu
```

## components/companion/Kconfig
```kconfig
menu "Companion input (knob)"

    config COMPANION_ENABLE
        bool "Enable companion knob UDP input"
        default n
        help
            Starts the UDP listener + mDNS advertisement (_moonclock._udp
            .local) that accepts the companion knob's binary frames. The
            listener only queues; the UI tick drains it.

    config COMPANION_TOKEN
        int "Shared token byte (0 = accept any frame)"
        range 0 255
        default 0
        depends on COMPANION_ENABLE
        help
            LAN-trusted posture: this byte keeps a curious neighbour off
            the dial, it is not a secret. Both sides must set it (knob
            side: knob/sdkconfig.defaults). 0 accepts any token.

    config COMPANION_PORT
        int "UDP listen port"
        range 1024 65535
        default 50188
        depends on COMPANION_ENABLE

    config COMPANION_KEEP_WIFI
        bool "Keep WiFi associated while companion is active (wall-powered boards)"
        default n
        depends on COMPANION_ENABLE
        help
            The clock normally runs airplane-first: the radio comes up
            only for the boot/on-demand sync and the airplane / light
            sleep hand-offs deinitialize it. That makes the UDP listener
            unreachable between syncs. With this option those hand-offs
            leave the radio ASSOCIATED, so the knob can deliver frames
            at any time. Costs radio power: right for the wall-powered
            P4 4C, wrong for the battery S3 (leave n). Deep sleep always
            deinits (the companion is useless while the clock is hidden).

endmenu
```

## components/knob_power/Kconfig
```kconfig
menu "Knob power (K7e)"

config KNOB_DIM_AFTER_S
    int "Idle seconds before the backlight dims (0 = never)"
    default 15
    range 0 3600
    help
        First rung of the ladder: the backlight duty drops to
        KNOB_DIM_DUTY after this much touch/dial silence. Any activity
        brings it back to full. P2 made the store authoritative: the
        light-sleep screen's roller (settings.txt idle_timeout_sec)
        drives this rung live, and this value is only the seed the
        supervisor falls back to while the store holds 0.

config KNOB_DIM_DUTY
    int "Dimmed backlight duty (0..255)"
    default 64
    range 1 254
    help
        LEDC duty while dimmed (full = 255, the vendor's "on"). 64 is the
        P1 dim parity value: 25 %, matching the clocks' light-sleep panel
        (UI_LIGHT_SLEEP_DIM_PCT); the shared clock widget dims to
        UI_CLOCK_ALPHA_PCT alongside it (knob_render_set_home_dim).

config KNOB_ALARM_TIMER_WAKE
    bool "Deep sleep: arm the internal RTC timer for the next alarm rule"
    default y
    help
        The user's alarm-across-deep-sleep choice: the knob ALWAYS deep
        sleeps, and the S3's internal RTC timer wakes it at the next
        rule time (+/- the RC drift, bench-checked at <= ~0.5 %). With n
        the knob sleeps GPIO-only (EXT0/EXT1) and alarms fire only while
        awake. The wake decision (fire / hold-to-rule-time / ignore) is
        main.c's arbitration; the never-early-ring rule lives there.

config KNOB_ALARM_GRACE_S
    int "TIMER wake counts as the alarm fire within +/- this many seconds"
    default 300
    range 30 900
    help
        The rule time the RTC timer was armed for, as recomputed from
        the NVS snapshot / SNTP on wake, may differ by the accumulated
        RC drift. Within +/- this window the wake IS the alarm (silent
        alarm visual). Outside it, a TIMER wake is either an early wake
        (hold to rule time, NEVER ring early) or stale (ignore).

config KNOB_ALARM_LATE_MAX_S
    int "Ignore a TIMER alarm wake this far off in either direction"
    default 900
    range 300 7200
    help
        Beyond GRACE the wake is arbitrated: early wakes within LATE_MAX
        wait at 1 Hz for the rule; anything further off (early or late)
        is treated as a stale/garbage timer fire -> a normal dial wake.

config KNOB_ALARM_MAX_SLEEP_GAP_S
    int "Sleep GPIO-only when the next rule is farther out than this"
    default 82800
    range 3600 172800
    help
        A weekday-mask gap (e.g. Friday night -> Monday 7:00 = ~60 h)
        exceeds any sane timer horizon; past this distance the knob
        sleeps on EXT0/EXT1 only and relies on a human/dial wake
        (23 h default covers the weekday case; > MAX means the
        scheduler's next-rule cache is the only timer source).

config KNOB_SLEEP_TIMEOUT_S
    int "Idle seconds before deep sleep (0 = never sleep)"
    default 60
    range 0 36000
    help
        Second rung: esp_deep_sleep_start with EXT0 on dial-A GPIO 8
        (active-LOW), one countdown AFTER the dim rung -- the clock's
        additive posture (sleep at idle_timeout + this countdown, both
        from the last activity). P2 made the store authoritative: the
        deep-sleep screen's roller (settings.txt
        deep_sleep_countdown_sec) drives the countdown live, and this
        value is only the seed the supervisor falls back to while the
        store holds 0. The cold-boot presentation HOLDS the ladder (a
        presentation is never interrupted); the clock's wake policy
        then shows the current phase statically on every boot and wake.

config KNOB_TOUCH_WAKE
    bool "Wake from deep sleep on a screen tap (EXT1 CST816S INT)"
    default y
    help
        Arms EXT1 ANY_LOW on the CST816S INT line (GPIO 9, RTC IO) next
        to the dial-A EXT0, so a tap wakes the knob like a dial detent
        does. Before sleeping, one touch status read clears a pending
        INT pulse (a stale low would re-wake instantly -- the boot-loop
        guard). If the pad rejects EXT1 the supervisor logs it and
        stays dial-only, like KNOB_SLEEP_ALLOW=n does for the sleep
        itself. Bench-verify: tap, then dial, from a dark panel.

config KNOB_SLEEP_ALLOW
    bool "Actually enter deep sleep (n = log-only)"
    default y
    help
        Bench development can keep the device reachable over the
        USB-JTAG serial with n: the supervisor logs the would-be sleep
        (including the EXT0 RTCIO verdict) and stays awake. Production
        ships y. The device page records which mode was benched.

endmenu
```

## components/moon/Kconfig
```kconfig
menu "Moon Phase Asset Configuration"

    config MOON_ALBEDO_W
        int "Equirect albedo texture width (px; height = width / 2)"
        # Kconfig evaluates multiple default lines FIRST-MATCH-WINS, so the
        # conditional line must precede the unconditional fallback.
        default 2048 if BOARD_P4
        default 864
        range 864 4096
        help
            The width of the equirect 2:1 albedo texture (in pixels; the
            height is width/2) baked from the 4096x2048 16-bit LROC
            source by the asset pipeline (assets/images/moon, gitignored)
            and flashed into the moon_assets partition. Both boards
            default to the best resolution their flash + PSRAM budgets
            allow (resolution over speed):

              S3 (16 MB flash, 8 MB PSRAM): 864 (432) -- 2,470,400 B of
                  the 2560K partition; 864 is the max the PSRAM pool can
                  spare (1024 would fill the partition exactly but adds
                  ~0.45 MB of asset PSRAM the pool cannot spare).
              P4 (32 MB flash, 32 MB PSRAM): 2048 (1024) -- 4,194,304 B
                  of the 5120K partition; matches the 2048-wide relief
                  DEM grid (1.57x oversampling at the 650 px disk).

            The width must be EVEN (equirect 2:1) and must match the
            generated assets: the root CMakeLists FATAL_ERRORs on an
            odd width or on a moon_assets.bin whose manifest width
            differs from this value, and refuses a blob that overflows
            the board's moon_assets partition (naming the KiB it needs).
            After changing it, regenerate the affected target:
              cd assets/images/moon && .venv/bin/python -m moon.assets \
                  --target p4 --alb 2560x1280
            (the Kconfig value only selects which pre-baked texture the
            build flashes; the texture itself is produced by the
            pipeline, never at compile time).

endmenu
```
